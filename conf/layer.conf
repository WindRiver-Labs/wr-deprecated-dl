## conf/layer.conf
```bitbake
#
# Copyright (C) 2021 Wind River Systems, Inc.
#
BBFILE_COLLECTIONS += "wr-deprecated-dl"
BBFILE_PATTERN_wr-deprecated-dl = ""
BBFILE_PATTERN_IGNORE_EMPTY_wr-deprecated-dl = "1"

# This should only be incremented on significant changes that will
# cause compatibility issues with other layers
LAYERVERSION_wr-deprecated-dl = "1"

LAYERSERIES_COMPAT_wr-deprecated-dl = "wrl hardknott"

# We have a pre-populated downloads directory, add to PREMIRRORS
PREMIRRORS_append = " \
     .*://.*/.* file://${LAYERDIR}/downloads/ \n \
     git://.*/.* git://${LAYERDIR}/git/MIRRORNAME;protocol=file \n \
"
```
